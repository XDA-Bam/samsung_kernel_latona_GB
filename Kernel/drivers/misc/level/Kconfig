## Kernel/drivers/misc/level/Kconfig
```kconfig
##
# Copyright (C) 2010-2011, Samsung Electronics, Co., Ltd. All Rights Reserved.
#  Written by System S/W Group, Open OS S/W R&D Team,
#  Mobile Communication Division.
##

##
# Project Name : Samsung Debug-Level Control Driver
#
# Project Description :
#
# Comments : tabstop = 8, shiftwidth = 8, noexpandtab
##

##
# File Name : Kconfig
#
# File Description :
#
# Author : System Platform 2
# Dept : System S/W Group (Open OS S/W R&D Team)
# Created : 27/Jan/2011
# Version : Baby-Raccoon
##

config SAMSUNG_DBG_LEVEL
	tristate "Samsung Debug-Level Control Support"
	default n
	help
		Say Y to enable Samsung Debug-Level Control support.
```

## Kernel/drivers/phone_svn/Kconfig
```kconfig
#
#
#

menuconfig SAMSUNG_PHONE_SVNET
	tristate "Samsung Phone Interface - SVN"
	default y
	---help---

if SAMSUNG_PHONE_SVNET

menuconfig PHONE_MODEMCTL 
	tristate "Modem Control"
	depends on SAMSUNG_PHONE_SVNET
	default m
	help
	  Say Y to enable Modem Control support.

menuconfig PHONE_ONEDRAM
	tristate "OneDRAM"
	depends on SAMSUNG_PHONE_SVNET
	default m
	help
	  Say Y to enable OneDRAM Interface support.

menuconfig PHONE_IPC_SPI
	tristate "IPC SPI"
	depends on SAMSUNG_PHONE_SVNET
	default m
	help
	  Say Y to enable IPC-SPI Interface support.

menuconfig PHONE_SVNET
	tristate "Samsung Virtual Network"
	depends on SAMSUNG_PHONE_SVNET
	default m
	help
	  Say Y to enable Samsung Virtual Network support

menuconfig PHONE_LOOPBACK_TEST
	tristate "SPI LoopBack Test"
	depends on SAMSUNG_PHONE_SVNET
	default n

menuconfig PHONE_STORAGE
	tristate "DGS Storage"
	depends on SAMSUNG_PHONE_SVNET
	default n

config SVNET_WHITELIST
	bool "svnet uses whitelist via onedram"
	default n
	---help---
	  By default, n

	  When in doubt, say N.


endif # SAMSUNG_PHONE_SVNET
```

## Kernel/drivers/switch/Kconfig
```kconfig
menuconfig SWITCH
	tristate "Switch class support"
	help
	  Say Y here to enable switch class support. This allows
	  monitoring switches by userspace via sysfs and uevent.

if SWITCH

config SWITCH_GPIO
	tristate "GPIO Swith support"
	depends on GENERIC_GPIO
	help
	  Say Y here to enable GPIO based switch support.

config SWITCH_SIO
	tristate "SIO Swith support"
	help
	  Say Y here to enable SIO switch support.

config SEC_HEADSET_CLASS_FOR_OMS
	tristate "Headset class for oms"
	help
	  Say Y here to enable oms sysfs support.

config INPUT_ZEUS_EAR_KEY
        tristate "EAR_KEY_DRIVER"
        help
          Say Y here if you want to enable ear key.

config EXTRA_DOCK_SPEAKER
        tristate "EXTRA_DOCK_SPEAKER"
        help
          Say Y here to enable extra dock speaker support
          
endif # SWITCH
```

## Kernel/drivers/usb/otg/Kconfig
```kconfig
#
# USB OTG infrastructure may be needed for peripheral-only, host-only,
# or OTG-capable configurations when OTG transceivers or controllers
# are used.
#

comment "OTG and related infrastructure"

config USB_OTG_UTILS
	bool
	help
	  Select this to make sure the build includes objects from
	  the OTG infrastructure directory.

if USB || USB_GADGET

#
# USB Transceiver Drivers
#
config USB_GPIO_VBUS
	tristate "GPIO based peripheral-only VBUS sensing 'transceiver'"
	depends on GENERIC_GPIO
	select USB_OTG_UTILS
	help
	  Provides simple GPIO VBUS sensing for controllers with an
	  internal transceiver via the otg_transceiver interface, and
	  optionally control of a D+ pullup GPIO as well as a VBUS
	  current limit regulator.

config ISP1301_OMAP
	tristate "Philips ISP1301 with OMAP OTG"
	depends on I2C && ARCH_OMAP_OTG
	select USB_OTG_UTILS
	help
	  If you say yes here you get support for the Philips ISP1301
	  USB-On-The-Go transceiver working with the OMAP OTG controller.
	  The ISP1301 is a full speed USB  transceiver which is used in
	  products including H2, H3, and H4 development boards for Texas
	  Instruments OMAP processors.

	  This driver can also be built as a module.  If so, the module
	  will be called isp1301_omap.

config USB_ULPI
	bool "Generic ULPI Transceiver Driver"
	depends on ARM
	select USB_OTG_UTILS
	help
	  Enable this to support ULPI connected USB OTG transceivers which
	  are likely found on embedded boards.

config TWL4030_USB
	tristate "TWL4030 USB Transceiver Driver"
	depends on TWL4030_CORE && REGULATOR_TWL4030
	select USB_OTG_UTILS
	help
	  Enable this to support the USB OTG transceiver on TWL4030
	  family chips (including the TWL5030 and TPS659x0 devices).
	  This transceiver supports high and full speed devices plus,
	  in host mode, low speed.

config TWL6030_USB
	tristate "TWL6030 USB Transceiver Driver"
	depends on TWL4030_CORE
	select USB_OTG_UTILS
	help
	  Enable this to support the USB OTG transceiver on TWL6030
	  family chips. this tranciever has the VBUS and ID GND and OTG
	  event capability. This tranciever does not have the USB PHY like TWL4030.

config NOP_USB_XCEIV
	tristate "NOP USB Transceiver Driver"
	select USB_OTG_UTILS
	help
	 this driver is to be used by all the usb transceiver which are either
	 built-in with usb ip or which are autonomous and doesn't require any
	 phy programming such as ISP1x04 etc.

config CPCAP_USB
	tristate "CPCAP USB Transceiver Driver"
	select USB_OTG_UTILS
	help
	  Enable this to support the USB OTG transceiver on the
	  Motorola CPCAP PMIC

config MICROUSBIC_INTR
	bool "MicroUSB IC interrupt handler"
	depends on TWL4030_USB

config SIDELOAD_EN
	bool "Sideload enable"
	depends on MACH_TICKERTAPE
	default y

config FSA9480_MICROUSB
	bool "FSA9480 MicroUSB Driver"
	depends on I2C && USB_GADGET

config FSA9480_NOTIFY_USB_CONNECTION_STATE
	bool "Notify USB Connection State"
	depends on FSA9480_MICROUSB
	default n
	
config FSA9480_GPIO_I2C
	bool "FSA9480 MicroUSB for GPIO Emulation I2C"
	depends on FSA9480_MICROUSB
	
config FSA9480_LINE_OUT
	bool "FSA9480 MicroUSB for LINE OUT"
	depends on FSA9480_MICROUSB
endif # USB || OTG
```

## Kernel/samsung/Kconfig
```kconfig
##
# Copyright (C) 2010, Samsung Electronics Co., Ltd. All Rights Reserved.
#  Written by System S/W Group, Open OS S/W R&D Team,
#  Mobile Communication Division.
##

##
# Project Name : Samsung Private Third-Party Device Drivers
#
# Project Description :
#
# Comments : tabstop = 8, shiftwidth = 8, noexpandtab
##

##
# File Name : Kconfig
#
# File Description :
#
# Author : Joo, Young Jin (#4349, youngjin79.joo@samsung.com)
# Dept : System S/W Group (Open OS S/W R&D Team)
# Created Date : 09-Jul-2010
# Version : Baby-Raccoon
##

menu "Samsung Private Third-Party Device Drviers"

menu "RFS_3.0.0_b040-LinuStoreIII_1.2.0_b038-FSR_1.2.1p1_b139_RC"
#source "samsung/rfs_fsr/drivers/fsr/Kconfig"
source "samsung/rfs_fsr/drivers/tfsr/Kconfig"
#source "samsung/rfs_fsr/fs/rfs/Kconfig"
endmenu

menu "Immersion touch sense driver(vibetonz)"
source "samsung/vibetonz/Kconfig"
endmenu

menu "Samsung battery driver"
source "samsung/battery/Kconfig"
endmenu

menu "Si4709 FM radio"
source "samsung/fm_si4709/Kconfig"
endmenu

menu "Samsung J4FS Support"
source "samsung/j4fs/Kconfig"
endmenu

menu "Samsung Param-Partition Support"
source "samsung/param/Kconfig"
endmenu

menu "Yamaha YAS529 Geomagnetic Sensor Support"
source "samsung/yas529/Kconfig"
endmenu

menu "Bosch BMA222 Accelerometer Support"
source "samsung/bma222/Kconfig"
endmenu

menu "Sharp GP2A proximity/light sensor"
source "samsung/gp2a/Kconfig"
endmenu

menu "Orientation Sensor Support"
source "samsung/orientation/Kconfig"
endmenu

menu "GPS Support"
source "samsung/gps/Kconfig"
endmenu

menu "ROHM Light Sensor Support"
source "samsung/bh1721/Kconfig"
endmenu

menu "ST K3G Gyroscope Sensor Support"
source "samsung/k3g/Kconfig"
endmenu

menu "Bosch BMA023 Accelerometer Support"
source "samsung/bma023/Kconfig"
endmenu

endmenu
```

## Kernel/samsung/battery/Kconfig
```kconfig
#menu "Samsung battery driver"

config SAMSUNG_BATTERY
	tristate "SAMSUNG_BATTERY"
	help
	 Say Y to include support for Samsung battery driver.
	default y
config SAMSUNG_BATTERY_TESTMODE
	bool "SAMSUNG_BATTERY_TESTMODE"	
	help
	 Say Y to test battery driver.
	depends on SAMSUNG_BATTERY
#endmenu
```

## Kernel/samsung/bh1721/Kconfig
```kconfig
config INPUT_BH1721
	tristate "ROHM Bh1721 Light Sensor"
	depends on I2C
	default n
```

## Kernel/samsung/fm_si4709/Kconfig
```kconfig
##
# Project Name : Samsung Private Third-Party Device Drivers
#
# Project Description :
#
# Comments : tabstop = 8, shiftwidth = 8, noexpandtab
##

##
# File Name : Kconfig
#
# File Description :
#
# Author : System Platform2
# Dept : System S/W Group (Open OS S/W R&D Team)
# Created Date : 16/Sep/2010
# Version : Baby-Raccoon
##

config FMRADIO
	tristate "Si4709 FM radio"
	default m
	help
		Si4709 FM radio

config FMRADIO_USE_GPIO_I2C
	tristate "Si4709 FM radio I2C"
	default n
```

## Kernel/samsung/gp2a/Kconfig
```kconfig
config INPUT_GP2A
	tristate "Sharp GP2A proximity/light sensor driver"
	default n
	help
	 Say Y to include support for Sharp GP2A proximity/light sensor.

config INPUT_GP2A_USE_GPIO_I2C
	tristate "Use GPIO I2C Emulation"
	default n
	help
	 Say Y to use I2C using GPIO.
	
```

## Kernel/samsung/j4fs/Kconfig
```kconfig
##
# Copyright (C) 2010, Samsung Electronics, Co., Ltd. All Rights Reserved.
#  Written by System S/W Group, Open OS S/W R&D Team,
#  Mobile Communication Division.
##

##
# Project Name : Samsung J4FS Support for Linux Kernel
#
# Project Description :
#
# Comments : tabstop = 8, shiftwidth = 8, noexpandtab
##

##
# File Name : Kconfig
#
# File Description :
#
# Author : Joo, Young Jin (#4349, youngjin79.joo@samsung.com)
# Dept : System S/W Group (Open OS S/W R&D Team)
# Created : 19/Sep/2010
# Version : Baby-Raccoon
##

config SAMSUNG_J4FS
	tristate "Samsung J4FS Support"
	default n
	help
		Say Y to enable Samsung J4FS support.

config SAMSUNG_J4FS_PHYSICAL_PAGE_SIZE
	int "Physical Page Size of NAND Device"
	default 4096

config SAMSUNG_J4FS_PHYSICAL_PAGE_PER_BLOCK
	int "Physical Pages-Per-Block Size"
	default 64

config SAMSUNG_J4FS_PARTITION_ID
	int "PARAM Partition ID"
	default 21

choice
	prompt "NAND Interface for J4FS"
	depends on SAMSUNG_J4FS
	default SAMSUNG_J4FS_USE_FSR

config SAMSUGN_J4FS_USE_XSR
	bool "J4FS use XSR Interface"

config SAMSUNG_J4FS_USE_FSR
	bool "J4FS use FSR Interface"

config SAMSUNG_J4FS_USE_EMMC
	bool "J4FS use eMMC Interface"

endchoice

config SAMSUNG_J4FS_BLOCK_COUNT
	int "Number of block used for J4FS in eMMC"
	depends on SAMSUNG_J4FS_USE_EMMC
	default 20

config SAMSUNG_J4FS_BASIC_UNIT_SIZE
	int "Basic unit size for j4fs_mst"
	default 2048

config SAMSUNG_J4FS_BASIC_UNIT_SIZE_BITS
	int "Basic unit size-bits for j4fs_mst"
	default 11
```

## Kernel/samsung/k3g/Kconfig
```kconfig
#
# GYRO Sensor Configuration
#
config INPUT_K3G
	tristate "K3G Gyroscope driver"
	default n
	help
	  This option enables gyro sensors using K3G driver

config INPUT_K3G_USE_GPIO_I2C
	tristate "K3G driver uses i2c via GPIO"
	default n
	help
	  This option enables K3G sensor via GPIO 
```

## Kernel/samsung/param/Kconfig
```kconfig
##
# Copyright (C) 2010, Samsung Electronics, Co., Ltd. All Rights Reserved.
#  Written by System S/W Group, Open OS S/W R&D Team,
#  Mobile Communication Division.
##

##
# Project Name : Samsung Param-Partition Support for Linux Kernel
#
# Project Description :
#
# Comments : tabstop = 8, shiftwidth = 8, noexpandtab
##

##
# File Name : Kconfig
#
# File Description :
#
# Author : Joo, Young Jin (#4349, youngjin79.joo@samsung.com)
# Dept : System S/W Group (Open OS S/W R&D Team)
# Created : 19/Sep/2010
# Version : Baby-Raccoon
##

config SAMSUNG_PARAM
	tristate "Samsung Param-Partition Support"
	default n
	help
		Say Y to enable Samsung Param support.
```

## Kernel/samsung/vibetonz/Kconfig
```kconfig
##
# Project Name : Samsung Private Third-Party Device Drivers
#
# Project Description :
#
# Comments : tabstop = 8, shiftwidth = 8, noexpandtab
##

##
# File Name : Kconfig
#
# File Description :
#
# Author : System Platform2
# Dept : System S/W Group (Open OS S/W R&D Team)
# Created Date : 15/Sep/2010
# Version : Baby-Raccoon
##

config SAMSUNG_VIBETONZ
	tristate "Immersion touch sense driver(vibetonz)"
	default m
	help
		Imersion touch sense driver(vibetonz)

config SAMSUNG_VIBETONZ_GPTIMER
	int "General Purpose Timer for VibeTonz (1 to 11)"
	depends on SAMSUNG_VIBETONZ
	default 10

config SAMSUNG_VIBETONZ_PWM_DUTY_MAX
	int "Maximum duty for PWM"
	depends on SAMSUNG_VIBETONZ
	default 580
```

## Kernel/samsung/yas529/Kconfig
```kconfig
config INPUT_YAS529
	tristate "Yamaha YAS529 geomagnetic sensor"
	default n
	help
		Say Y to enable YAS529 geomagnetic support.

config INPUT_YAS529_POSITION
	int "YAS529 Mounting Position on Board"
	depends on INPUT_YAS529
	default "0"
	help
	  Chip mounting position (pin 1).
	    0: top, upper-left
	    1: top, upper-right
	    2: top, lower-right
	    3: top, lower-left
	    4: bottom, upper-left
	    5: bottom, upper-right
	    6: bottom, lower-right
	    7: bottom, lower-left

config INPUT_YAS529_USE_GPIO_I2C
	tristate "Yamaha YAS529 I2C Policy"
	default n
	help
		Say Y to use I2C using GPIO
```
